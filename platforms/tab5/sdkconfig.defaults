## platforms/tab5/sdkconfig.defaults
```kconfig
CONFIG_IDF_TARGET="esp32p4"
CONFIG_ESPTOOLPY_FLASHMODE_QIO=y
CONFIG_ESPTOOLPY_FLASHSIZE_16MB=y
CONFIG_PARTITION_TABLE_CUSTOM=y
CONFIG_COMPILER_OPTIMIZATION_PERF=y
CONFIG_SPIRAM=y
CONFIG_SPIRAM_SPEED_200M=y
CONFIG_SPIRAM_XIP_FROM_PSRAM=y
CONFIG_CACHE_L2_CACHE_256KB=y
CONFIG_CACHE_L2_CACHE_LINE_128B=y
CONFIG_FREERTOS_HZ=1000
CONFIG_FREERTOS_VTASKLIST_INCLUDE_COREID=y
CONFIG_FREERTOS_GENERATE_RUN_TIME_STATS=y
CONFIG_ESP_BROOKESIA_MEMORY_USE_CUSTOM=y
CONFIG_LV_COLOR_SCREEN_TRANSP=y
CONFIG_LV_MEM_CUSTOM=y
CONFIG_LV_MEMCPY_MEMSET_STD=y
CONFIG_LV_DISP_DEF_REFR_PERIOD=25
CONFIG_LV_USE_LOG=y
CONFIG_LV_LOG_PRINTF=y
CONFIG_LV_USE_PERF_MONITOR=y
CONFIG_LV_ATTRIBUTE_FAST_MEM_USE_IRAM=y
CONFIG_LV_FONT_MONTSERRAT_8=y
CONFIG_LV_FONT_MONTSERRAT_10=y
CONFIG_LV_FONT_MONTSERRAT_12=y
CONFIG_LV_FONT_MONTSERRAT_16=y
CONFIG_LV_FONT_MONTSERRAT_18=y
CONFIG_LV_FONT_MONTSERRAT_20=y
CONFIG_LV_FONT_MONTSERRAT_22=y
CONFIG_LV_FONT_MONTSERRAT_24=y
CONFIG_LV_FONT_MONTSERRAT_26=y
CONFIG_LV_FONT_MONTSERRAT_28=y
CONFIG_LV_FONT_MONTSERRAT_30=y
CONFIG_LV_FONT_MONTSERRAT_32=y
CONFIG_LV_FONT_MONTSERRAT_34=y
CONFIG_LV_FONT_MONTSERRAT_36=y
CONFIG_LV_FONT_MONTSERRAT_38=y
CONFIG_LV_FONT_MONTSERRAT_40=y
CONFIG_LV_FONT_MONTSERRAT_42=y
CONFIG_LV_FONT_MONTSERRAT_44=y
CONFIG_LV_FONT_FMT_TXT_LARGE=y
CONFIG_LV_USE_FONT_COMPRESSED=y
CONFIG_LV_USE_DEMO_BENCHMARK=y
CONFIG_IDF_EXPERIMENTAL_FEATURES=y

# Nova: Tab5 芯片为早期 rev v1.3，放宽 bootloader 版本检查（AIO box 同芯片可跑）
CONFIG_ESP32P4_REV_MIN_100=y
CONFIG_ESP32P4_SELECTS_REV_LESS_V3=y
# Nova: 跳过 I2C 新旧驱动冲突检查（触摸组件用 legacy，主代码用新驱动）
CONFIG_I2C_SKIP_LEGACY_CONFLICT_CHECK=y
# Nova: esp_codec_dev 用新 I2C 驱动（否则 legacy 驱动未装报错）
CONFIG_CODEC_I2C_BACKWARD_COMPATIBLE=n
# Nova: C6 SDIO 固件不匹配导致 esp_hosted 崩溃重启，先禁用（UI 稳定优先，WiFi 后补）
CONFIG_ESP_HOSTED_ENABLED=n
CONFIG_ESP_WIFI_REMOTE_ENABLED=n
# Nova: M5Tab5 实际 P4<->C6 SDIO 引脚（AIO box 日志实锤 CLK12/CMD13/D0 11/D1 10/D2 9/D3 8）
CONFIG_ESP_HOSTED_SDIO_PIN_CLK=12
CONFIG_ESP_HOSTED_SDIO_PIN_CMD=13
CONFIG_ESP_HOSTED_SDIO_PIN_D0=11
CONFIG_ESP_HOSTED_SDIO_PIN_D1=10
CONFIG_ESP_HOSTED_SDIO_PIN_D2=9
CONFIG_ESP_HOSTED_SDIO_PIN_D3=8
CONFIG_ESP_HOSTED_SDIO_PRIV_PIN_D1_4BIT_BUS=10
# Nova: esp_hosted slave 是 C6（原 sdkconfig 被重建丢失此项，导致 host 期望 ESP32 握手失败）
CONFIG_SLAVE_IDF_TARGET_ESP32C6=y
CONFIG_SLAVE_IDF_TARGET_ESP32=n

# Nova: 中文字体 + 拼音输入法（CONFIG_LV_CONF_SKIP=y，配置必须走 sdkconfig）
CONFIG_LV_FONT_SIMSUN_14_CJK=y
CONFIG_LV_FONT_SIMSUN_16_CJK=y
CONFIG_LV_USE_IME_PINYIN=y

# Nova: LVGL 全局默认字体改中文（否则未设字体的控件画中文=方框）
CONFIG_LV_FONT_DEFAULT_SIMSUN_16_CJK=y

# 截图回传（供开发期自动检查 UI）
CONFIG_LV_USE_SNAPSHOT=y
```
